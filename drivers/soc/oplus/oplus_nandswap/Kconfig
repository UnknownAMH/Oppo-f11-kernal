## drivers/soc/oplus/oplus_nandswap/Kconfig
```kconfig
config NANDSWAP
	tristate "NAND Swap Support"
	depends on MMU
	help
	  Enable NAND swap support for MTK platforms.

config NANDSWAP_DEBUG
	bool "NAND Swap Debug"
	depends on NANDSWAP
	default n
	help
	  Enable NAND swap debug features.
```
